## config/boards/shields/my_keyboard/Kconfig.defconfig
```kconfig
# ====================================================
#  Kconfig.defconfig
#  Sets the USB product name and keyboard identity.
# =====================================================
if SHIELD_MY_KEYBOARD

config ZMK_KEYBOARD_NAME
    default "Supaaaa Keyboard"    #might change it to a serious one later (prolly not)

config ZMK_USB_BOOT
    default y

endif
```

## config/boards/shields/my_keyboard/Kconfig.shield
```kconfig
# ==========================
#  Kconfig.shield
#  ZMK's build system reads this to know the godam keyboard exists. genuinely why dose this exist
# ===========================

config SHIELD_MY_KEYBOARD
    def_bool $(shields_list_contains,my_keyboard)
```
